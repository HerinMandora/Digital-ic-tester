/**
  ******************************************************************************
  * @file    oled.c
  * @brief   SSD1306 0.96" 128x64 I2C OLED driver.
  ******************************************************************************
  */

#include "oled.h"
#include "main.h"
#include "i2c1_reg.h"
#include <string.h>

#define SSD1306_I2C_ADDR   0x3C          /* 7-bit SSD1306 address */
#define SSD1306_WIDTH      128
#define SSD1306_PAGES      8

static uint8_t oled_buffer[SSD1306_WIDTH * SSD1306_PAGES];

/* Minimal 5x7 font, ASCII 0x20-0x5F (space through '_'), covers all
 * characters used by this project's UI (uppercase letters, digits,
 * punctuation). Each is 5 columns, 1 byte per column (LSB = top). */
static const uint8_t font5x7[][5] = {
    {0x00,0x00,0x00,0x00,0x00}, /* space */
    {0x00,0x00,0x5F,0x00,0x00}, /* ! */
    {0x00,0x07,0x00,0x07,0x00}, /* " */
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    {0x40,0x40,0x40,0x40,0x40}, /* _ */
};

static void I2C_WriteCmd(uint8_t cmd)
{
    uint8_t buf[2] = {0x00, cmd};
    I2C1_MasterTransmit(SSD1306_I2C_ADDR, buf, 2);
}

static void I2C_WriteData(uint8_t *data, uint16_t len)
{
    /* Send in chunks prefixed with control byte 0x40 (data) */
    uint8_t tmp[17];
    uint16_t sent = 0;
    while (sent < len)
    {
        uint16_t chunk = (len - sent > 16) ? 16 : (len - sent);
        tmp[0] = 0x40;
        memcpy(&tmp[1], &data[sent], chunk);
        I2C1_MasterTransmit(SSD1306_I2C_ADDR, tmp, chunk + 1);
        sent += chunk;
    }
}

void OLED_Init(void)
{
    HAL_Delay(100);
    I2C_WriteCmd(0xAE); /* display off */
    I2C_WriteCmd(0x20); I2C_WriteCmd(0x00); /* horizontal addressing mode */
    I2C_WriteCmd(0xB0);
    I2C_WriteCmd(0xC8); /* COM scan dir */
    I2C_WriteCmd(0x00);
    I2C_WriteCmd(0x10);
    I2C_WriteCmd(0x40);
    I2C_WriteCmd(0x81); I2C_WriteCmd(0xFF); /* contrast */
    I2C_WriteCmd(0xA1); /* segment remap */
    I2C_WriteCmd(0xA6); /* normal display */
    I2C_WriteCmd(0xA8); I2C_WriteCmd(0x3F);
    I2C_WriteCmd(0xA4);
    I2C_WriteCmd(0xD3); I2C_WriteCmd(0x00);
    I2C_WriteCmd(0xD5); I2C_WriteCmd(0xF0);
    I2C_WriteCmd(0xD9); I2C_WriteCmd(0x22);
    I2C_WriteCmd(0xDA); I2C_WriteCmd(0x12);
    I2C_WriteCmd(0xDB); I2C_WriteCmd(0x20);
    I2C_WriteCmd(0x8D); I2C_WriteCmd(0x14); /* charge pump on */
    I2C_WriteCmd(0xAF); /* display on */

    OLED_Clear();
    OLED_Update();
}

void OLED_Clear(void)
{
    memset(oled_buffer, 0x00, sizeof(oled_buffer));
}

void OLED_Update(void)
{
    for (uint8_t page = 0; page < SSD1306_PAGES; page++)
    {
        I2C_WriteCmd(0xB0 + page);
        I2C_WriteCmd(0x00);
        I2C_WriteCmd(0x10);
        I2C_WriteData(&oled_buffer[page * SSD1306_WIDTH], SSD1306_WIDTH);
    }
}

static void OLED_DrawChar(uint8_t x, uint8_t page, char c)
{
    if (page >= SSD1306_PAGES) return;
    if (c < 0x20 || c > 0x5F) c = 0x20;
    const uint8_t *glyph = font5x7[c - 0x20];
    for (uint8_t col = 0; col < 5; col++)
    {
        uint16_t px = x + col;
        if (px >= SSD1306_WIDTH) return;
        oled_buffer[page * SSD1306_WIDTH + px] = glyph[col];
    }
}

void OLED_PrintAt(uint8_t x, uint8_t page, const char *text)
{
    uint8_t cx = x;
    while (*text)
    {
        char c = *text++;
        /* lowercase -> uppercase, font only covers 0x20-0x5F */
        if (c >= 'a' && c <= 'z') c -= 32;
        OLED_DrawChar(cx, page, c);
        cx += 6; /* 5px glyph + 1px spacing */
        if (cx >= SSD1306_WIDTH) break;
    }
}

void OLED_PrintNumberAt(uint8_t x, uint8_t page, uint32_t number)
{
    char buf[11];
    int i = 10;
    buf[10] = '\0';
    if (number == 0)
    {
        buf[--i] = '0';
    }
    else
    {
        while (number > 0 && i > 0)
        {
            buf[--i] = (char)('0' + (number % 10));
            number /= 10;
        }
    }
    OLED_PrintAt(x, page, &buf[i]);
}
